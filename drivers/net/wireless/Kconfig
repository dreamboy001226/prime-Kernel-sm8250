## drivers/net/wireless/Kconfig
```kconfig
#
# Wireless LAN device configuration
#

menuconfig WLAN
    bool "Wireless LAN"
    depends on NET
    default y
    help
      This section contains all the pre‑802.11 and 802.11 wireless
      device drivers. For a complete list of drivers and documentation
      refer to the wireless wiki: http://wireless.kernel.org/en/users/Drivers

if WLAN

config WIRELESS_WDS
    bool "mac80211-based legacy WDS support" if EXPERT
    help
      Deprecated WDS support. Superseded by mac80211 4‑addr AP/client.

source "drivers/net/wireless/admtek/Kconfig"
source "drivers/net/wireless/ath/Kconfig"
source "drivers/net/wireless/atmel/Kconfig"
source "drivers/net/wireless/broadcom/Kconfig"
source "drivers/net/wireless/cisco/Kconfig"
source "drivers/net/wireless/intel/Kconfig"
source "drivers/net/wireless/intersil/Kconfig"
source "drivers/net/wireless/marvell/Kconfig"
source "drivers/net/wireless/mediatek/Kconfig"
source "drivers/net/wireless/ralink/Kconfig"
source "drivers/net/wireless/realtek/Kconfig"
source "drivers/net/wireless/rsi/Kconfig"
source "drivers/net/wireless/st/Kconfig"
source "drivers/net/wireless/ti/Kconfig"
source "drivers/net/wireless/zydas/Kconfig"
source "drivers/net/wireless/quantenna/Kconfig"

config PCMCIA_RAYCS
    tristate "Aviator/Raytheon 2.4GHz wireless support"
    depends on PCMCIA
    select WIRELESS_EXT
    select WEXT_SPY
    select WEXT_PRIV
    help
      Support for Aviator/Raytheon PCMCIA wireless cards.

config PCMCIA_WL3501
    tristate "Planet WL3501 PCMCIA cards"
    depends on CFG80211 && PCMCIA
    select WIRELESS_EXT
    select WEXT_SPY
    help
      Driver for WL3501 PCMCIA 802.11 cards.

config MAC80211_HWSIM
    tristate "Simulated radio testing tool for mac80211"
    depends on MAC80211
    help
      Developer testing tool for mac80211 functionality.

config USB_NET_RNDIS_WLAN
    tristate "Wireless RNDIS USB support"
    depends on USB && CFG80211
    select USB_NET_DRIVERS
    select USB_USBNET
    select USB_NET_CDCETHER
    select USB_NET_RNDIS_HOST
    help
      Driver for Broadcom‑based RNDIS USB WLAN adapters.

config VIRT_WIFI
    tristate "Wifi wrapper for ethernet drivers"
    depends on CFG80211
    help
      Makes ethernet connections appear as wifi.

config WCNSS_MEM_PRE_ALLOC
    tristate "WCNSS pre-alloc memory support"
    help
      Pre‑allocate memory for WLAN driver module.

config CLD_LL_CORE
    tristate "QTI core WLAN driver for QCA6174 chipset"
    select WEXT_CORE
    select WEXT_PRIV
    select WEXT_SPY
    select WIRELESS_EXT
    help
      Core WLAN driver for QTI QCA6174 chipset.

source "drivers/net/wireless/cnss2/Kconfig"
source "drivers/net/wireless/cnss_utils/Kconfig"
source "drivers/net/wireless/cnss_genl/Kconfig"

# Qualcomm WLAN driver
config QCA6390_QCACLD
    tristate "Qualcomm QCA6390 WLAN driver"
    depends on !NO_QCACLD
    help
      Enable Qualcomm QCA6390 WLAN driver (qcacld‑3.0).

source "drivers/net/wireless/qualcomm/qca6390/qcacld-3.0/Kconfig"

endif # WLAN
```
